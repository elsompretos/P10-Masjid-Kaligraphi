// https://dotmatrixtool.com/
// byte order : row major
// endian : big endian

#include <DMD3asis.h>
DMD3 display(1, 1);
int mode = 0;
int bsh;
/* Millis */
unsigned long millis_all = 0;

void setup() {
  Timer1.initialize(2000);
  Timer1.attachInterrupt(scan);
  Timer1.pwm(9, 10);
  display.setDoubleBuffer(1);
  display.clear();

}

void loop() {
  switch (mode) {
    case 0:
      LogoMasjid();
      break;
    case 1:
      LogoAllahdanMuhammad();
      break;
  }
}
void scan() {
  display.refresh();
}

void LogoAllahdanMuhammad() {
  static const uint8_t LogoAllah[] PROGMEM = {
    16, 16,
    0x00, 0x00, 0x7f, 0xfe, 0x7f, 0xfe, 0x00, 0x00, 0x00, 0x00, 0x7e, 0x66, 0x7e, 0x66, 0x06, 0x66, 0x06, 0x66, 0x7e, 0x66, 0x7e, 0x66, 0x66, 0x66, 0x66, 0x66, 0x7f, 0xfe, 0x7f, 0xfe, 0x00, 0x00
  };
  static const uint8_t LogoMuhammad[] PROGMEM = {
    16, 16,
    0x00, 0x00, 0x66, 0x7e, 0x66, 0x7e, 0x66, 0x66, 0x66, 0x66, 0x7e, 0x7e, 0x7e, 0x7e, 0x60, 0x60, 0x60, 0x60, 0x7e, 0x7e, 0x7e, 0x7e, 0x66, 0x06, 0x66, 0x06, 0x7f, 0xfe, 0x7f, 0xfe, 0x00, 0x00
  };

  if ((millis() - millis_all) > 50) {
    millis_all = millis();
    display.clear();
    if (bsh < 75) {
      bsh++;

      if (bsh < 17) {
        display.drawBitmap((bsh - 16), 0,  LogoMuhammad);
        display.drawBitmap(-1*(bsh - 32), 0,  LogoAllah);
      }
      else if ((bsh > 16) && (bsh < 58))
      {
        display.drawBitmap(0, 0, LogoMuhammad);
        display.drawBitmap(16, 0, LogoAllah);
      }
      else if (bsh > 57) {
        display.drawBitmap(-1 * (bsh - 58), 0,  LogoMuhammad);
        display.drawBitmap((bsh - 42), 0,  LogoAllah);
      }


      display.swapBuffers();

    }
    else
    {
      bsh = 0;
      mode = 0;
    }
  }
}

void LogoallahMuhammad() {
  static const uint8_t LogoallahMuhammad[] PROGMEM = {
    32, 16,
    0x00, 0x00, 0x00, 0x00, 0x66, 0x7e, 0x7f, 0xfe, 0x66, 0x7e, 0x7f, 0xfe,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 0x00
  };
  display.clear();
  display.drawBitmap(0, 0, LogoallahMuhammad);
  display.swapBuffers();
}

void LogoMasjid() {
  static const uint8_t LogoMasjid[] PROGMEM = {
    32, 16,
    0x10, 0x00, 0x80, 0x04, 0x10, 0x01, 0xc0, 0x04, 0x10, 0x03, 0xe0, 0x04,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 0x6a
  };
  if ((millis() - millis_all) > 50) {
    millis_all = millis();
    display.clear();
    if (bsh < 75) {
      bsh++;

      if (bsh < 17) {
        display.drawBitmap(0, -1 * (bsh - 16),  LogoMasjid);
      }
      else if ((bsh > 16) && (bsh < 58))
      {
        display.drawBitmap(0, 0, LogoMasjid);
      }
      else if (bsh > 57) {
        display.drawBitmap(0, -57 + bsh, LogoMasjid);
      }


      display.swapBuffers();

    }
    else
    {
      bsh = 0;
      mode = 1;
    }
  }
}
